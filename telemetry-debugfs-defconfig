## telemetry-debugfs-defconfig
```kconfig
# configs for telemetry debugfs support
CONFIG_INTEL_VSEC=m
CONFIG_INTEL_PMT_TELEMETRY=m
CONFIG_INTEL_PMC_CORE=m

# PMC for BTX/GLK
CONFIG_INTEL_PUNIT_IPC=m
CONFIG_MFD_INTEL_PMC_BXT=m
CONFIG_INTEL_TELEMETRY=m
```
